## esp32_firmware/components/david-cermak__liboqs_mlkem/examples/custom_pqc_channel/main/Kconfig.projbuild
```kconfig
menu "Example Configuration"

    config SERVER_SIDE
        bool "Is server side"
        default n
        help
            Set to true to configure the project as server.
            false -> client

endmenu
```
